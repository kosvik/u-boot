## arch/arm/mach-rockchip/rk3328/Kconfig
```kconfig
if ROCKCHIP_RK3328

choice
	prompt "RK3328 board select"

config TARGET_EVB_RK3328
	bool "RK3328 evaluation board"
	help
	  RK3328evb is a evaluation board for Rockchip rk3328,
	  with full function and phisical connectors support like
	  usb2.0 host ports, LVDS, JTAG, MAC, SDcard, HDMI, USB-2-serial...

config TARGET_Z28PRO_RK3328
	bool "Z28 Pro TV Box"
	help
	  Z28 Pro is a tv box on Rockchip rk3328...

endchoice

config SYS_SOC
	default "rockchip"

config SYS_MALLOC_F_LEN
	default 0x0800

source "board/rockchip/evb_rk3328/Kconfig"
source "board/rockchip/z28pro_rk3328/Kconfig"

endif
```

## board/rockchip/z28pro_rk3328/Kconfig
```kconfig
if TARGET_Z28PRO_RK3328

config SYS_BOARD
	default "z28pro_rk3328"

config SYS_VENDOR
	default "rockchip"

config SYS_CONFIG_NAME
	default "z28pro_rk3328"

config BOARD_SPECIFIC_OPTIONS # dummy
	def_bool y

endif
```
